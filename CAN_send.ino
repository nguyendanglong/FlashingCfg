// CAN Send Example
//

#include <mcp_can.h>
#include <SPI.h>

MCP_CAN CAN0(9);     // Set CS to pin 9

void setup()
{
  Serial.begin(115200);

  // Initialize MCP2515 running at 16MHz with a baudrate of 500kb/s and the masks and filters disabled.
  if(CAN0.begin(MCP_ANY, CAN_500KBPS, MCP_8MHZ) == CAN_OK) 
        Serial.println("MCP2515 Initialized Successfully!");
  else Serial.println("Error Initializing MCP2515...");

  CAN0.setMode(MCP_NORMAL);   // Change to normal mode to allow messages to be transmitted
}

//#define UINT8_MAX  0xFF
#define CRC_idx 0
#define cnt_idx 1

uint8_t  CRC8_J1850_TABLE[256] =
{
0x00, 0x1D, 0x3A, 0x27, 0x74, 0x69, 0x4E, 0x53,
0xE8, 0xF5, 0xD2, 0xCF, 0x9C, 0x81, 0xA6, 0xBB,
0xCD, 0xD0, 0xF7, 0xEA, 0xB9, 0xA4, 0x83, 0x9E,
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0x97, 0x8A, 0xAD, 0xB0, 0xE3, 0xFE, 0xD9, 0xC4
};

uint8_t crclib_getCRC8( uint8_t *xData, uint8_t xDataLen)
{
  uint8_t idx;
  uint8_t crc = UINT8_MAX;
  crc=255;
  for (idx = 1 ; idx <= xDataLen; idx++ ) 
  {
    crc = CRC8_J1850_TABLE[crc ^ (xData[idx])];
  }
  crc ^= UINT8_MAX;
  return crc;
}

  uint8_t data1A1[5] = {0x00, 0x00, 0x00, 0x00, 0x0A};
  uint8_t data3F9[8] = {0x00, 0x00, 0x80, 0x00, 0x00, 0x00, 0x00, 0x00};
  uint8_t data112[6] = {0x00, 0x20, 0x00, 0x01, 0x01, 0x00};
  uint8_t sndStat;
  
void loop()
{
  // alive counter
  data1A1[cnt_idx]++;
  if (0x0F == data1A1[cnt_idx])
  {
    data1A1[cnt_idx] = 0x00;
  }
  // CRC calculation
  data1A1[CRC_idx] = crclib_getCRC8(data1A1, 4);
  
  // send data:  ID = 0x1A1, Standard CAN Frame, Data length = 5 bytes, 'data' = array of data bytes to send
  byte sndStat = CAN0.sendMsgBuf(0x1A1, 0, 5, data1A1);
  if(sndStat == CAN_OK){
    Serial.println("Message 0x1A1 Sent Successfully!");
  } else {
    Serial.println("Error Sending Message 0x1A1 ...");
  }

  // alive counter
  static uint8_t cnt_3F9 =0;
  cnt_3F9++;
  if(cnt_3F9 == 0x0F)
  {
    cnt_3F9 =0;
  }
  
  uint8_t temp = data3F9[cnt_idx] & 0xF0;
  data3F9[cnt_idx] = temp | cnt_3F9;
  
  // CRC calculation
  data3F9[CRC_idx] = crclib_getCRC8(data3F9, 7);
    sndStat = CAN0.sendMsgBuf(0x3F9, 0, 8, data3F9);
  if(sndStat == CAN_OK){
    Serial.println("Message 0x3F9 Sent Successfully!");
  } else {
    Serial.println("Error Sending Message 0x3F9 ...");
  }

  // alive counter
  static uint8_t cnt_112 = 0;
  cnt_112++;
  if(cnt_112 == 0x0F)
  {
    cnt_112 = 0;
  }
  temp = data112[cnt_idx] & 0xF0;
  data112[cnt_idx] = temp | cnt_112;
  
  // CRC calculation
  data112[CRC_idx] = crclib_getCRC8(data112, 5);
  
    sndStat = CAN0.sendMsgBuf(0x112, 0, 6, data112);
  if(sndStat == CAN_OK){
    Serial.println("Message 0x112 Sent Successfully!");
  } else {
    Serial.println("Error Sending Message 0x112 ...");
  }
  delay(50);   // send data per 100ms
}

/*********************************************************************************************************
  END FILE
*********************************************************************************************************/
